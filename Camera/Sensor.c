#include "Sensor.h"
#include "myfun.h"
#include "stc15.h"
#include "uart_debug.h"
const  char OV7670_reg[OV7670_REG_NUM][2]=
{       
       
        {0x3a, 0x04},
        {0x40, 0xd0},
        {0x12, 0x14},
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        {0x3b, 0x42},//0x82,//0xc0,//0xc2,        //night mode
};




/*char code OV7670_reg[OV7670_REG_NUM][2]=
{	 
 
     *//*以下为OV7670 QVGA RGB565参数 
  	{0x3a, 0x04},//dummy
	{0x40, 0x10},//565
	{0x12, 0x14},//@
	{0x32, 0x80},//HREF control	bit[2:0] HREF start 3 LSB	 bit[5:3] HSTOP HREF end 3LSB
	{0x17, 0x16},//              HSTART start high 8-bit MSB
        
	{0x18, 0x04},//5	 HSTOP end high 8-bit
	{0x19, 0x02},
	{0x1a, 0x7b},//0x7a,
	{0x03, 0x06},//0x0a,
	{0x0c, 0x0c},
        {0x15, 0x02},
	{0x3e, 0x00},//10
	{0x70, 0x00},
	{0x71, 0x01},
	{0x72, 0x11},
	{0x73, 0x09},//
        
	{0xa2, 0x02},//15
	{0x11, 0x03}, //fenpin
	{0x7a, 0x20},
	{0x7b, 0x1c},
	{0x7c, 0x28},
        
	{0x7d, 0x3c},//20
	{0x7e, 0x55},
	{0x7f, 0x68},
	{0x80, 0x76},
	{0x81, 0x80},
        
	{0x82, 0x88},
	{0x83, 0x8f},
	{0x84, 0x96},
	{0x85, 0xa3},
	{0x86, 0xaf},
        
	{0x87, 0xc4},//30
	{0x88, 0xd7},
	{0x89, 0xe8},
	{0x13, 0xe0},
	{0x00, 0x00},//AGC
        
	{0x10, 0x00},
	{0x0d, 0x00},
	{0x14, 0x20},//0x38, limit the max gain
	{0xa5, 0x05},
	{0xab, 0x07},
        
	{0x24, 0x75},//40
	{0x25, 0x63},
	{0x26, 0xA5},
	{0x9f, 0x78},
	{0xa0, 0x68},
        
	{0xa1, 0x03},//0x0b,
	{0xa6, 0xdf},//0xd8,
	{0xa7, 0xdf},//0xd8,
	{0xa8, 0xf0},
	{0xa9, 0x90},
        
	{0xaa, 0x94},//50
	{0x13, 0xe5},
	{0x0e, 0x61},
	{0x0f, 0x4b},
	{0x16, 0x02},
        
	{0x1e, 0x37},//0x07,
	{0x21, 0x02},
	{0x22, 0x91},
	{0x29, 0x07},
	{0x33, 0x0b},
        
	{0x35, 0x0b},//60
	{0x37, 0x1d},
	{0x38, 0x71},
	{0x39, 0x2a},
	{0x3c, 0x78},
        
	{0x4d, 0x40},
	{0x4e, 0x20},
	{0x69, 0x5d},
	{0x6b, 0x40},//PLL
	{0x74, 0x19},
	{0x8d, 0x4f},
        
	{0x8e, 0x00},//70
	{0x8f, 0x00},
	{0x90, 0x00},
	{0x91, 0x00},
	{0x92, 0x00},//0x19,//0x66
        
	{0x96, 0x00},
	{0x9a, 0x80},
	{0xb0, 0x84},
	{0xb1, 0x0c},
	{0xb2, 0x0e},
        
	{0xb3, 0x82},//80
	{0xb8, 0x0a},
	{0x43, 0x14},
	{0x44, 0xf0},
	{0x45, 0x34},
        
	{0x46, 0x58},
	{0x47, 0x28},
	{0x48, 0x3a},
	{0x59, 0x88},
	{0x5a, 0x88},
        
	{0x5b, 0x44},//90
	{0x5c, 0x67},
	{0x5d, 0x49},
	{0x5e, 0x0e},
	{0x64, 0x04},
	{0x65, 0x20},
        
	{0x66, 0x05},
	{0x94, 0x04},
	{0x95, 0x08},
	{0x6c, 0x0a},
	{0x6d, 0x55},
        
        
	{0x4f, 0x80},
	{0x50, 0x80},
	{0x51, 0x00},
	{0x52, 0x22},
	{0x53, 0x5e},
	{0x54, 0x80},
        
	//{0x54, 0x40},//110
        
        
	{0x6e, 0x11},//100
	{0x6f, 0x9f},//0x9e for advance AWB
        {0x55, 0x00},//亮度
        {0x56, 0x20},//对比度
        {0x57, 0x40},//0x40,  change according to Jim's request	      

};*/

//=================================================
//功能：写OV7660寄存器
//返回：1-成功	0-失败
//=================================================

unsigned char wr_Sensor_Reg(unsigned char regID, unsigned char regDat)
{
 startSCCB(); //发送SCCB 总线开始传输命令

 if(0==SCCBwriteByte(0x42))//写地址
 {	
  stopSCCB();//发送SCCB 总线停止传输命令
  return(0);//错误返回
 }

 //delay(50000);

 UART_Put_Inf("wr_Sensor_Reg:",1);
 //SendString("wr_Sensor_Reg:");

 if(0==SCCBwriteByte(regID))//积存器ID
 {
  stopSCCB();//发送SCCB 总线停止传输命令
  return(0); //错误返回
 }

 //delay(50000);
 UART_Put_Inf("wr_Sensor_Reg:",2);
 //SendString("wr_Sensor_Reg:");

 if(0==SCCBwriteByte(regDat))//写数据到积存器
 {
  stopSCCB();//发送SCCB 总线停止传输命令
  return(0);//错误返回
 }

 stopSCCB();//发送SCCB 总线停止传输命令

 UART_Put_Inf("wr_Sensor_Reg:",3);
 //SendString("wr_Sensor_Reg:");

 return(1);//成功返回
}

//=================================================
//功能：读OV7660寄存器
//返回：1-成功	0-失败
//===================================================
unsigned char rd_Sensor_Reg(unsigned char regID, unsigned char *regDat)
{
 //通过写操作设置寄存器地址

 startSCCB();

 if(0==SCCBwriteByte(0x42))//写地址
 {
  stopSCCB();//发送SCCB 总线停止传输命令
  return(0);//错误返回
 }
	
 //delay(50000);

 if(0==SCCBwriteByte(regID))//积存器ID
 {
  stopSCCB();//发送SCCB 总线停止传输命令
  return(0);//错误返回
 }
 stopSCCB();//发送SCCB 总线停止传输命令
	
 //delay(50000);
	
 //设置寄存器地址后，才是读
 startSCCB();

 if(0==SCCBwriteByte(0x43))//读地址
 {
  stopSCCB();//发送SCCB 总线停止传输命令
  return(0);//错误返回
 }
	
 //delay(50000);
 *regDat=SCCBreadByte();//返回读到的值

 noAck();//发送NACK命令
 stopSCCB();//发送SCCB 总线停止传输命令

 return(1);//成功返回
}

//===============================================
//Sensor_init()  摄像头芯片初始化
//返回1成功，返回0失败
//=================================================
unsigned char Sensor_init(void)
{
 unsigned char idata temp;	
 unsigned int idata i=0;

 //XCLK_init_ON();//开启MCO功能 提供时钟给CMOS传感器
 //uchar ovidmsb=0,ovidlsb=0;
 //Sensor_GPIO_Init();
 //SCCB_GPIO_Config();//io init..
        
 temp=0x80;
	
 if(0==wr_Sensor_Reg(0x12,temp)) //Reset SCCB
 {
  UART_Put_Inf("Reset SCCB error",temp);
  return 0 ;//错误返回
 }
	
 //delay(50000);
 UART_Put_Inf("Sensor_init:",1);
 //SendString("Sensor_init:");


	
 
 //SendString("Sensor_init2:");

 while(temp!=0x73)
 {
 	if(0==rd_Sensor_Reg(0x0b, &temp))//读ID
 	{
 	 UART_Put_Inf("Read Id error",temp);
 	 return 0 ;//错误返回
 	}
 	UART_Put_Inf("Sensor_init:",temp);
 }

 if(temp==0x73)//OV7670
 {
  for(i=0;i<OV7670_REG_NUM;i++)
  {
   //delay(500);
   UART_Put_Inf("Sensor_init:cycle",i);
   //SendString("Sensor_init:cycle");

   if(0==wr_Sensor_Reg(OV7670_reg[i][0],OV7670_reg[i][1]))
   {
    UART_Put_Inf("Sensor_init:cycle error",i);
	return 0;//错误返回
   }
  }
 }

 UART_Put_Inf("Sensor_init:ok",0);
 //SendString("Sensor_init:ok");

 return 1; //ok
} 

///////////////////

